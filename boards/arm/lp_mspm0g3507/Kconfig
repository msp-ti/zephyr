## boards/arm/lp_mspm0g3507/Kconfig.board
```kconfig
# TI LP_MSPM0G3507 Development Board

# SPDX-License-Identifier: Apache-2.0

config BOARD_LP_MSPM0G3507
	bool "TI LP_MSPM0G3507"
	depends on SOC_MSPM0G3507
```

## boards/arm/lp_mspm0g3507/Kconfig.defconfig
```kconfig
# TI LP_MSPM0G3507 development board configuration

# SPDX-License-Identifier: Apache-2.0

config BOARD
	default "lp_mspm0g3507"
	depends on BOARD_LP_MSPM0G3507
```

## boards/arm/lp_mspm0g3507/lp_mspm0g3507_defconfig
```kconfig
# SPDX-License-Identifier: Apache-2.0

CONFIG_BOARD_LP_MSPM0G3507=y
CONFIG_SOC_SERIES_MSPM0G3XXX=y
CONFIG_SOC_MSPM0G3507=y
CONFIG_CORTEX_M_SYSTICK=y
CONFIG_BUILD_OUTPUT_HEX=y

# enable gpio driver
CONFIG_GPIO=y

# enable uart driver
CONFIG_SERIAL=y

# enable console
CONFIG_CONSOLE=y
CONFIG_UART_CONSOLE=y

# enable pinctrl
CONFIG_PINCTRL=y
```

## drivers/adc/Kconfig.mspm0g3xxx
```kconfig
# SPDX-License-Identifier: Apache-2.0

config ADC_MSPM0G3XXX
	bool "TI ADC MSPM0G3XXX driver"
	default y
	depends on DT_HAS_TI_MSPM0G3XXX_ADC_ENABLED
	help
	  Enable support for ADC on the TI MSPM0G3XXX series.
```

## drivers/can/Kconfig.mspm0g3xxx
```kconfig
# SPDX-License-Identifier: Apache-2.0

config CAN_MSPM0G3XXX_CANFD
	bool "MSPM0G3XXX CANFD driver"
	default y
	depends on DT_HAS_TI_MSPM0G3XXX_CANFD_ENABLED
	select CAN_MCAN
	help
	  Enable support for CANFD on the TI MSPM0G3XXX series.

if CAN_MSPM0G3XXX_CANFD

config CAN_MAX_STD_ID_FILTER
	int "Maximum number of standard (11-bit) ID filters"
	default 128
	range 0 128
	help
	  Defines the maximum number of filters with standard ID (11-bit)
	  that can be added by the application.

config CAN_MAX_EXT_ID_FILTER
	int "Maximum number of extended (29-bit) ID filters"
	default 64
	range 0 64
	help
	  Defines the maximum number of filters with extended ID (29-bit)
	  that can be added by the application.

endif # CAN_MSPM0G3XXX_CANFD
```

## drivers/i2c/Kconfig.mspm0g3xxx
```kconfig
# SPDX-License-Identifier: Apache-2.0

config I2C_MSPM0G3XXX
	bool "TI I2C MSPM0G3XXX driver"
	default y
	depends on DT_HAS_TI_MSPM0G3XXX_I2C_ENABLED
	help
	  Enable support for I2C on the TI MSPM0G3XXX series.
```

## drivers/pinctrl/Kconfig.mspm0g3xxx
```kconfig
# SPDX-License-Identifier: Apache-2.0

config PINCTRL_MSPM0G3XXX
	bool "TI pinctrl MSPM0G3XXX driver"
	default y
	depends on DT_HAS_TI_MSPM0G3XXX_PINCTRL_ENABLED
	help
	  Enable support for the PINCTRL on TI MSPM0G3XXX series.
```

## drivers/serial/Kconfig.mspm0g3xxx
```kconfig
# SPDX-License-Identifier: Apache-2.0

config UART_MSPM0G3XXX
	bool "MSPM0G3XXX UART driver"
	default y
	depends on DT_HAS_TI_MSPM0G3XXX_UART_ENABLED
	select SERIAL_HAS_DRIVER
	select SERIAL_SUPPORT_INTERRUPT
	help
	  This option enables the MSPM0G3XXX UART driver for UART0.
```

## drivers/spi/Kconfig.mspm0
```kconfig
# Copyright (C) 2024 Bang & Olufsen A/S, Denmark
# SPDX-License-Identifier: Apache-2.0

config SPI_MSPM0
	bool "TI MSPM0 SPI driver"
	default n
	depends on DT_HAS_TI_MSPM0_SPI_ENABLED
	help
	  Enable driver for TI MSPM0 SPI.
```

## dts/bindings/can/ti,mspm0g3xxx-canfd.yaml
```yaml
# SPDX-License-Identifier: Apache-2.0

description: TI MSPM0G3XXX CANFD

compatible: "ti,mspm0g3xxx-canfd"

include: ["bosch,m_can-base.yaml", "pinctrl-device.yaml"]

properties:
  reg:
    required: true

  interrupts:
    required: true

  clocks:
    required: true

  clk-divider:
    type: int
    enum:
      - 1
      - 2
      - 4

    description: |
      Clock divide ratio specification. Enables configuring clock divide
      settings for the MCAN functional clock input to the MCAN-SS.
      Divide by 1 is the default unless the property is configured.
```

## dts/bindings/gpio/ti,mspm0g3xxx-gpio.yaml
```yaml
# SPDX-License-Identifier: Apache-2.0

description: TI MSPM0G3XXX GPIO

compatible: "ti,mspm0g3xxx-gpio"

include: [gpio-controller.yaml, base.yaml]

properties:
  reg:
    required: true

  interrupts:
    required: true

  "#gpio-cells":
    const: 2

gpio-cells:
  - pin
  - flags
```

## dts/bindings/i2c/ti,mspm0g3xxx-i2c.yaml
```yaml
# SPDX-License-Identifier: Apache-2.0

description: TI MSPM0G3XXX I2C

compatible: "ti,mspm0g3xxx-i2c"

include: [i2c-controller.yaml, pinctrl-device.yaml, base.yaml]

properties:
  reg:
    required: true

  interrupts:
    required: true

  pinctrl-0:
    required: true

  pinctrl-names:
    required: true
```

## dts/bindings/serial/ti,mspm0g3xxx-uart.yaml
```yaml
description: TI MSPM0G3XXX UART

compatible: "ti,mspm0g3xxx-uart"

include: [uart-controller.yaml, pinctrl-device.yaml, base.yaml]

properties:
  reg:
    required: true

  interrupts:
    required: true

  pinctrl-0:
    required: true

  pinctrl-names:
    required: true
```

## dts/bindings/smbus/ti,mspm0-smbus.yaml
```yaml
# Copyright (c) 2024 Texas Instruments
# SPDX-License-Identifier: Apache-2.0

description: |
    TI MSPM0 SMBUS implementation, put on top of a
    capable I2C peripheral in order to follow the SMBUS protocol as either
    a controller or a target

compatible: "ti,mspm0-smbus"

include: base.yaml

properties: 
  i2c: 
    type: phandle
    required: true
    description: The underlying I2C instance
```

## dts/bindings/spi/ti,mspm0-spi.yaml
```yaml
# Copyright (C) 2024 Bang & Olufsen A/S, Denmark
# SPDX-License-Identifier: Apache-2.0

description: TI MSPM0 SPI controller

compatible: "ti,mspm0-spi"

include: [spi-controller.yaml, pinctrl-device.yaml]

properties:
  reg:
    required: true

  pinctrl-0:
    required: true

  pinctrl-names:
    required: true
```

## modules/Kconfig.mspm0
```kconfig
# MSPM0 SDK configuration

# SPDX-License-Identifier: Apache-2.0

config HAS_MSPM0SDK
	bool
```

## samples/boards/ti/mspm0g3xxx/i2c/sample.yaml
```yaml
sample:
  name: I2C Controller RW Multibyte FIFO Poll for TI MSPM0G3XXX
tests:
  sample.boards.ti.mspm0g3xxx.i2c:
    build_only: true
    platform_allow: lp_mspm0g3xxx
    tags: i2c
```

## soc/arm/ti_mspm0/Kconfig
```kconfig
# Texas Instruments MSPM0 Family

# SPDX-License-Identifier: Apache-2.0

config SOC_FAMILY_TIMSPM0
	bool
	select BUILD_OUTPUT_BIN
	select LINKER_LAST_SECTION_ALIGN_8
	select HAS_MSPM0SDK

if SOC_FAMILY_TIMSPM0

config SOC_FAMILY
	string
	default "ti_mspm0"

source "soc/arm/ti_mspm0/*/Kconfig.soc"

endif # SOC_FAMILY_TIMSPM0
```

## soc/arm/ti_mspm0/Kconfig.defconfig
```kconfig
# SPDX-License-Identifier: Apache-2.0

source "soc/arm/ti_mspm0/*/Kconfig.defconfig.series"
```

## soc/arm/ti_mspm0/Kconfig.soc
```kconfig
# Texas Instruments MSPM0 Family

# SPDX-License-Identifier: Apache-2.0

source "soc/arm/ti_mspm0/*/Kconfig.series"
```

## soc/arm/ti_mspm0/mspm0g3xxx/Kconfig.defconfig.series
```kconfig
# TI MSPM0G3XXX

# SPDX-License-Identifier: Apache-2.0

if SOC_SERIES_MSPM0G3XXX

source "soc/arm/ti_mspm0/mspm0g3xxx/Kconfig.defconfig.mspm0g3*"

config SOC_SERIES
	default "mspm0g3xxx"

endif # SOC_SERIES_MSPM0G3XXX
```

## soc/arm/ti_mspm0/mspm0g3xxx/Kconfig.series
```kconfig
# TI MSPM0G3XXX

# SPDX-License-Identifier: Apache-2.0

config SOC_SERIES_MSPM0G3XXX
	bool "TI MSPM0 Family MSPM0G3XXX"
	select ARM
	select CPU_CORTEX_M0PLUS
	select CPU_CORTEX_M_HAS_VTOR
	select CPU_HAS_ARM_MPU
	select SOC_FAMILY_TIMSPM0
	select CPU_CORTEX_M_HAS_SYSTICK
	help
	  Enable support for TI MSPM0G3XXX.
```

## soc/arm/ti_mspm0/mspm0g3xxx/Kconfig.soc
```kconfig
# Texas Instruments MSPM0G3507

# SPDX-License-Identifier: Apache-2.0

choice
	prompt "TI MSPM0 MCU Selection"
	depends on SOC_SERIES_MSPM0G3XXX

config SOC_MSPM0G3507
	bool "MSPM0G3507"
endchoice
```
