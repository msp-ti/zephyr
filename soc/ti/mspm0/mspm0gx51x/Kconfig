## soc/ti/mspm0/mspm0gx51x/Kconfig
```kconfig
# TI MSPM0GX51X

# Copyright (c) 2025 Texas Instruments
# SPDX-License-Identifier: Apache-2.0

config SOC_SERIES_MSPM0GX51X
	select ARM
	select CPU_CORTEX_M0PLUS
	select CPU_CORTEX_M_HAS_VTOR
	select CPU_HAS_ARM_MPU
	select CPU_CORTEX_M_HAS_SYSTICK
	select BUILD_OUTPUT_BIN
	select BUILD_OUTPUT_HEX
	select HAS_MSPM0_SDK
	select CLOCK_CONTROL
```

## soc/ti/mspm0/mspm0gx51x/Kconfig.defconfig
```kconfig
# TI MSPM0GX51X

# Copyright (c) 2024 Texas Instruments
# SPDX-License-Identifier: Apache-2.0


if SOC_SERIES_MSPM0GX51X

DT_MSPM0_CLKMUX_PATH := $(dt_nodelabel_path,clkmux)
DT_MSPM0_CLKMUX_CPU_FREQ := $(dt_node_int_prop_int,$(DT_MSPM0_CLKMUX_PATH),clock-frequency)

config NUM_IRQS
	default 32

config SYS_CLOCK_HW_CYCLES_PER_SEC
	default "$(DT_MSPM0_CLKMUX_CPU_FREQ)" if "$(dt_nodelabel_enabled,clkmux)"

endif # SOC_SERIES_MSPM0GX51X
```

## soc/ti/mspm0/mspm0gx51x/Kconfig.defconfig.mspm0g1518
```kconfig
# TI MSPM0G1518 SoC

# Copyright (c) 2025 Texas Instruments
# SPDX-License-Identifier: Apache-2.0

if SOC_MSPM0G1518

config SOC
	default "mspm0g1518"

config NUM_IRQS
	default 32

endif # SOC_MSPM0G1518
```

## soc/ti/mspm0/mspm0gx51x/Kconfig.defconfig.mspm0g1519
```kconfig
# TI MSPM0G1519 SoC

# Copyright (c) 2025 Texas Instruments
# SPDX-License-Identifier: Apache-2.0

if SOC_MSPM0G1519

config SOC
	default "mspm0g1519"

config NUM_IRQS
	default 32

endif # SOC_MSPM0G1519
```

## soc/ti/mspm0/mspm0gx51x/Kconfig.defconfig.mspm0g3518
```kconfig
# TI MSPM0G3518 SoC

# Copyright (c) 2025 Texas Instruments
# SPDX-License-Identifier: Apache-2.0

if SOC_MSPM0G3518

config SOC
	default "mspm0g3518"

config NUM_IRQS
	default 32

endif # SOC_MSPM0G3518
```

## soc/ti/mspm0/mspm0gx51x/Kconfig.defconfig.mspm0g3519
```kconfig
# TI MSPM0G3519 SoC

# Copyright (c) 2025 Texas Instruments
# SPDX-License-Identifier: Apache-2.0

if SOC_MSPM0G3519

config SOC
	default "mspm0g3519"

config NUM_IRQS
	default 32

endif # SOC_MSPM0G3519
```

## soc/ti/mspm0/mspm0gx51x/Kconfig.soc
```kconfig
# Copyright (c) 2024 Texas Instruments
# SPDX-License-Identifier: Apache-2.0

config SOC_SERIES_MSPM0GX51X
	bool
	select SOC_FAMILY_TI_MSPM0
	help
	  Enable support for TI MSPM0GX51X SoCs

config SOC_MSPM0G1518
	bool
	select SOC_SERIES_MSPM0GX51X

config SOC_MSPM0G1519
	bool
	select SOC_SERIES_MSPM0GX51X

config SOC_MSPM0G3518
	bool
	select SOC_SERIES_MSPM0GX51X

config SOC_MSPM0G3519
	bool
	select SOC_SERIES_MSPM0GX51X

config SOC_SERIES
	default "mspm0gx51x" if SOC_SERIES_MSPM0GX51X

config SOC
	default "mspm0g1518" if SOC_MSPM0G1518
	default "mspm0g1519" if SOC_MSPM0G1519
	default "mspm0g3518" if SOC_MSPM0G3518
	default "mspm0g3519" if SOC_MSPM0G3519
```
